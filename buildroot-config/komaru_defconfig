## buildroot-config/komaru_defconfig
```kconfig
# Architecture
BR2_arm=y
BR2_cortex_a53=y
BR2_ARM_ENABLE_VFP=y

# System
BR2_TARGET_GENERIC_HOSTNAME="komaru"
BR2_TARGET_GENERIC_ISSUE="Welcome to KomaruOS"
BR2_SYSTEM_BIN_SH_BUSYBOX=y
BR2_SYSTEM_DHCP="eth0"
BR2_ROOTFS_DEVICE_CREATION_DYNAMIC_EUDEV=y

# Toolchain
BR2_TOOLCHAIN_BUILDROOT_GLIBC=y

# Packages
BR2_PACKAGE_BUSYBOX=y
BR2_PACKAGE_BUSYBOX_CONFIG="package/busybox/busybox-komaru.config"

# Kernel
BR2_LINUX_KERNEL=y
BR2_LINUX_KERNEL_USE_CUSTOM_CONFIG=y
BR2_LINUX_KERNEL_CUSTOM_CONFIG_FILE="$(KOMARU_DIR)/kernel-config"
BR2_LINUX_KERNEL_PATCH="$(KOMARU_DIR)/kernel-patches/"
BR2_LINUX_KERNEL_IMAGE=y

# Komaru specific
BR2_PACKAGE_KOMARU_DRIVERS=y
BR2_PACKAGE_KOMARU_DEVTOOL=y

# Target options
BR2_TARGET_ROOTFS_EXT2=y
BR2_TARGET_ROOTFS_EXT2_4=y
BR2_TARGET_ROOTFS_EXT2_SIZE="512M"
```
